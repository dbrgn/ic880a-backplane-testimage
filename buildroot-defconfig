## buildroot-defconfig
```kconfig
# Support packages that might also be provided by busybox
BR2_PACKAGE_BUSYBOX_SHOW_OTHERS=y

# Timezone
BR2_TARGET_TZ_INFO=y
BR2_TARGET_TZ_ZONELIST="default"
BR2_TARGET_LOCALTIME="Europe/Zurich"

# Overlays
BR2_ROOTFS_OVERLAY="board/ic880a-backplane/rootfs-overlay/"
BR2_ROOTFS_POST_BUILD_SCRIPT="board/ic880a-backplane/post-build.sh"
BR2_ROOTFS_POST_FAKEROOT_SCRIPT=""
BR2_ROOTFS_POST_IMAGE_SCRIPT="board/ic880a-backplane/post-image.sh"
BR2_ROOTFS_POST_SCRIPT_ARGS=""

# Root FS
BR2_TARGET_ROOTFS_EXT2_LABEL="rootfs"
BR2_TARGET_ROOTFS_EXT2_SIZE="100M"

# Toolchain
BR2_TOOLCHAIN_BUILDROOT_WCHAR=y
BR2_USE_WCHAR=y
BR2_USE_MMU=y

# Shell
BR2_PACKAGE_BASH=y
BR2_PACKAGE_READLINE=y
BR2_SYSTEM_BIN_SH_BASH=y
BR2_SYSTEM_BIN_SH="bash"

# Packages
BR2_PACKAGE_I2C_TOOLS=y
BR2_PACKAGE_LM_SENSORS=y
BR2_PACKAGE_LM_SENSORS_SENSORS=y
BR2_PACKAGE_PYTHON3=y
BR2_PACKAGE_PYTHON3_PYC_ONLY=y
BR2_PACKAGE_PYTHON_RPI_GPIO=y
BR2_PACKAGE_PYTHON_SETUPTOOLS=y
BR2_PACKAGE_VIM=y
BR2_PACKAGE_VIM_RUNTIME=y
```
